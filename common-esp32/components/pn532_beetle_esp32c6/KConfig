## common-esp32/components/pn532_beetle_esp32c6/KConfig
```kconfig
menu "Doorlock / PN532 GPIO Pins"

config PN532_SPI_CS_PIN_NUMBER
	int "SPI Chip Select GPIO Pin Number"
	range 0 30
	default 16

config PN532_RSTPD_PIN_NUMBER
	int "PN532 RSTPD GPIO Pin Number"
	range 0 30
	default 17

config PN532_SPI_MISO_PIN_NUMBER
	int "SPI MISO GPIO Pin Number"
	range 0 30
	default 21

config PN532_SPI_MOSI_PIN_NUMBER
	int "SPI MOSI GPIO Pin Number"
	range 0 30
	default 22

config PN532_SPI_SCK_PIN_NUMBER
	int "SPI SCK GPIO Pin Number"
	range 0 30
	default 23

endmenu
```

## esp32-cardreader/main/KConfig
```kconfig
menu "Doorlock / MQTT"
	config MQTT_BROKER_HOSTNAME
		string "broker hostname"
		default "test.mosquitto.org"
		help
			MQTT broker for published measurements

	config MQTT_USE_TLS
		bool "MQTT use encryption (TLS)"
		default false
		help
			Connect to broker using TLS. The public key file of the certificate authority (CA) that was used to sign the brokers public key needs to be present in common/config/ca.crt

	if MQTT_USE_TLS
	config MQTT_TLS_CLIENT_AUTH
	depends on MQTT_USE_TLS
	bool "MQTT use client authentication (TLS)"
	default false
	help
		Authenticate this client against the broker. The client certificate needs to be present in common/config/client.crt, the key in common/config/client.key
	endif
endmenu
```

## esp32-cardreader/main/KConfig.projbuild
```kconfig
menu "Door lock"
menu "GPIO Pins"
source "../../common-esp32/components/pn532_beetle_esp32c6/KConfig.pn532"
endmenu
menu "MQTT"
	config MQTT_BROKER_HOSTNAME
		string "MQTT broker hostname"
		default "test.mosquitto.org"
		help
			MQTT broker for published measurements

	config MQTT_TOPIC_ROOT
		string "MQTT root topic"
		default "random237865235/cardreader"
		help
			The prefix to the MQTT topic - can be extended using console setup

	config MQTT_USE_TLS
		bool "MQTT use encryption (TLS)"
		default false
		help
			Connect to broker using TLS. The public key file of the certificate authority (CA) that was used to sign the brokers public key needs to be present in common/config/ca.crt

	if MQTT_USE_TLS
	config MQTT_TLS_CLIENT_AUTH
	depends on MQTT_USE_TLS
	bool "MQTT use client authentication (TLS)"
	default false
	help
		Authenticate this client against the broker. The client certificate needs to be present in common/config/client.crt, the key in common/config/client.key
	endif
endmenu
endmenu
```

## esp32-dooropener/main/KConfig
```kconfig
menu "Doorlock / MQTT"
	config MQTT_BROKER_HOSTNAME
		string "broker hostname"
		default "test.mosquitto.org"
		help
			MQTT broker for published measurements

	config MQTT_USE_TLS
		bool "MQTT use encryption (TLS)"
		default false
		help
			Connect to broker using TLS. The public key file of the certificate authority (CA) that was used to sign the brokers public key needs to be present in common/config/ca.crt

	if MQTT_USE_TLS
	config MQTT_TLS_CLIENT_AUTH
		depends on MQTT_USE_TLS
		bool "MQTT use client authentication (TLS)"
		default false
		help
			Authenticate this client against the broker. The client certificate needs to be present in common/config/client.crt, the key in common/config/client.key
	endif
endmenu

menu "Doorlock / Relay"
	config RELAY_GPIO_PIN
	int "GPIO pin number"
	default 20
	help
		3.3V pin configured as output to control the relay. Not to drive the solenoid directly: it needs a control circuit that can be driven be a logic signal.
endmenu
```
